## bare_drivers/Kconfig
```kconfig
menu "Bare Device Drivers"

config BAREMETAL_OS
    bool "Baremetal OS Enable"
    default y
    help
      Enable Baremetal OS drivers.

if BAREMETAL_OS

config BAREMETAL_REG_DEBUG
    int "Enable register print debug"
    default 0
    help
      Enable baremetal OS registers print.
config BAREMETAL_LOGLEVEL
    int "Baremetal LOG level."
    default 3
    help
      print log level(0=off,1=error, 2=warn, 3=info, 4=debug).


source "bare_drivers/hello/Kconfig"

source "bare_drivers/leds/Kconfig"

endif

endmenu
```

## bare_drivers/global_data/Kconfig
```kconfig
#
# Leds infrastructure and drivers
#

menuconfig BAREMETAL_GD
    bool "Global data dump support"
    default y
    help
      Enable support for dump gd.
```

## bare_drivers/hello/Kconfig
```kconfig
#
# Hello infrastructure and drivers
#

menuconfig BAREMETAL_HELLO
    bool "HELLO Driver support"
    default n
    help
      Enable support for hello driver test.

if BAREMETAL_HELLO

config BAREMETAL_HELLO_PRINT
    bool "Enable Baremetal Hello Driver For BaremetalOS"
    default y
    help
      Enable hello driver support.

endif
```

## bare_drivers/leds/Kconfig
```kconfig
#
# Leds infrastructure and drivers
#

menuconfig BAREMETAL_LED
    bool "LED Driver support"
    depends on LED && LED_GPIO
    default n
    help
      Enable support for LED driver test.
```

## drivers/Kconfig
```kconfig
menu "Device Drivers"

source "drivers/core/Kconfig"

# types of drivers sorted in alphabetical order

source "drivers/adc/Kconfig"

source "drivers/block/Kconfig"

source "drivers/clk/Kconfig"

source "drivers/crypto/Kconfig"

source "drivers/demo/Kconfig"

source "drivers/fastboot/Kconfig"

source "drivers/gpio/Kconfig"

source "drivers/i2c/Kconfig"

source "drivers/input/Kconfig"

source "drivers/led/Kconfig"

source "drivers/misc/Kconfig"

source "drivers/mmc/Kconfig"

source "drivers/mtd/Kconfig"

source "drivers/net/Kconfig"

source "drivers/phy/Kconfig"

source "drivers/pinctrl/Kconfig"

source "drivers/pwm/Kconfig"

source "drivers/ram/Kconfig"

source "drivers/reset/Kconfig"

source "drivers/rng/Kconfig"

source "drivers/serial/Kconfig"

source "drivers/spi/Kconfig"

source "drivers/sysreset/Kconfig"

source "drivers/usb/Kconfig"


source "drivers/video/Kconfig"

config PHYS_TO_BUS
	bool "Custom physical to bus address mapping"
	help
	  Some SoCs use a different address map for CPU physical addresses and
	  peripheral DMA master accesses. If yours does, select this option in
	  your platform's Kconfig, and implement the appropriate mapping
	  functions in your platform's support code.

endmenu
```

## drivers/adc/Kconfig
```kconfig
config ADC
	bool "Enable ADC drivers using Driver Model"
	help
	  This enables ADC API for drivers, which allows driving ADC features
	  by single and multi-channel methods for:
	  - start/stop/get data for conversion of a single-channel selected by
	    a number or multi-channels selected by a bitmask
	  - get data mask (ADC resolution)
	  ADC reference Voltage supply options:
	  - methods for get Vdd/Vss reference Voltage values with polarity
	  - support supply's phandle with auto-enable
	  - supply polarity setting in fdt

config SARADC_ROCKCHIP
	bool "Enable Rockchip SARADC driver"
	help
	  This enables driver for Rockchip SARADC.
	  It provides:
	  - 2~6 analog input channels
	  - 1O or 12 bits resolution
	  - Up to 1MSPS of sample rate
```
